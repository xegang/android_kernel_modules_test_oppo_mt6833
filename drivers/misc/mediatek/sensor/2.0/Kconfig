## drivers/misc/mediatek/sensor/2.0/Kconfig
```kconfig
# SPDX-License-Identifier: GPL-2.0

source "drivers/misc/mediatek/sensor/2.0/mtk_nanohub/Kconfig"
source "drivers/misc/mediatek/sensor/2.0/sensorhub/Kconfig"
source "drivers/misc/mediatek/sensor/2.0/test/Kconfig"
source "drivers/misc/mediatek/sensor/2.0/lsm6dsm_secondary/Kconfig"
source "vendor/oplus/sensor/kernel/oplus_virtual_sensor/Kconfig"
source "vendor/oplus/sensor/kernel/oplus_virtual_sensor/sensors/camera_protecthub/Kconfig"
source "vendor/oplus/sensor/kernel/oplus_virtual_sensor/sensors/free_fallhub/Kconfig"
source "vendor/oplus/sensor/kernel/oplus_virtual_sensor/sensors/pickup_detecthub/Kconfig"
source "vendor/oplus/sensor/kernel/oplus_virtual_sensor/sensors/fp_displayhub/Kconfig"
source "vendor/oplus/sensor/kernel/oplus_virtual_sensor/sensors/lux_aodhub/Kconfig"
source "vendor/oplus/sensor/kernel/oplus_virtual_sensor/sensors/pedo_minutehub/Kconfig"
source "vendor/oplus/sensor/kernel/oplus_virtual_sensor/sensors/elevator_detecthub/Kconfig"
source "vendor/oplus/sensor/kernel/oplus_virtual_sensor/sensors/oplus_activity_recognitionhub/Kconfig"
source "vendor/oplus/sensor/kernel/oplus_sensor_devinfo/Kconfig"
source "vendor/oplus/sensor/kernel/oplus_virtual_sensor/sensors/sensor_monitor/Kconfig"
source "drivers/misc/mediatek/sensor/2.0/mn29005/Kconfig"
```

## vendor/oplus/kernel/network/Kconfig
```kconfig
# SPDX-License-Identifier: GPL-2.0-only
# Copyright (C) 2018-2020 Oplus. All rights reserved.

source "vendor/oplus/kernel/network/oplus_dns_hook/Kconfig"

source "vendor/oplus/kernel/network/oplus_stats_calc/Kconfig"

source "net/oplus_modules/oplus_qr_scan/Kconfig"
```

## vendor/oplus/kernel/touchpanel/oplus_touchscreen/Focal/Kconfig
```kconfig
source "vendor/oplus/kernel/touchpanel/oplus_touchscreen/Focal/FT8006/Kconfig"
source "vendor/oplus/kernel/touchpanel/oplus_touchscreen/Focal/ft3518/Kconfig"
source "vendor/oplus/kernel/touchpanel/oplus_touchscreen/Focal/ft8006s_aa/Kconfig"
source "vendor/oplus/kernel/touchpanel/oplus_touchscreen/Focal/ft3681/Kconfig"
source "vendor/oplus/kernel/touchpanel/oplus_touchscreen/Focal/ft3658u/Kconfig"
```

## vendor/oplus/kernel/touchpanel/oplus_touchscreen/Goodix/Kconfig
```kconfig
source "vendor/oplus/kernel/touchpanel/oplus_touchscreen/Goodix/Goodix_gt5688/Kconfig"
source "vendor/oplus/kernel/touchpanel/oplus_touchscreen/Goodix/GT9286/Kconfig"
source "vendor/oplus/kernel/touchpanel/oplus_touchscreen/Goodix/GT9886/Kconfig"
```

## vendor/oplus/kernel/touchpanel/oplus_touchscreen/Himax/Kconfig
```kconfig
source "vendor/oplus/kernel/touchpanel/oplus_touchscreen/Himax/hx83112b/Kconfig"
source "vendor/oplus/kernel/touchpanel/oplus_touchscreen/Himax/hx83112a_noflash/Kconfig"
source "vendor/oplus/kernel/touchpanel/oplus_touchscreen/Himax/hx83112b_noflash/Kconfig"
source "vendor/oplus/kernel/touchpanel/oplus_touchscreen/Himax/hx83102d_noflash/Kconfig"
source "vendor/oplus/kernel/touchpanel/oplus_touchscreen/Himax/hx83112f_noflash/Kconfig"
```

## vendor/oplus/kernel/touchpanel/oplus_touchscreen/Samsung/Kconfig
```kconfig
source "vendor/oplus/kernel/touchpanel/oplus_touchscreen/Samsung/S6SY791/Kconfig"
source "vendor/oplus/kernel/touchpanel/oplus_touchscreen/Samsung/S6SY792/Kconfig"
source "vendor/oplus/kernel/touchpanel/oplus_touchscreen/Samsung/S6SY761/Kconfig"
source "vendor/oplus/kernel/touchpanel/oplus_touchscreen/Samsung/S6D7AT0/Kconfig"
source "vendor/oplus/kernel/touchpanel/oplus_touchscreen/Samsung/S6SY771/Kconfig"
```

## vendor/oplus/kernel/touchpanel/oplus_touchscreen/Synaptics/Kconfig
```kconfig
source "vendor/oplus/kernel/touchpanel/oplus_touchscreen/Synaptics/S3508/Kconfig"
source "vendor/oplus/kernel/touchpanel/oplus_touchscreen/Synaptics/S3320/Kconfig"
source "vendor/oplus/kernel/touchpanel/oplus_touchscreen/Synaptics/S3706/Kconfig"
source "vendor/oplus/kernel/touchpanel/oplus_touchscreen/Synaptics/S4322/Kconfig"
source "vendor/oplus/kernel/touchpanel/oplus_touchscreen/Synaptics/TD4310/Kconfig"
source "vendor/oplus/kernel/touchpanel/oplus_touchscreen/Synaptics/Syna_tcm/Kconfig"
source "vendor/oplus/kernel/touchpanel/oplus_touchscreen/Synaptics/Syna_tcm_oncell/Kconfig"
source "vendor/oplus/kernel/touchpanel/oplus_touchscreen/Synaptics/S1302_virtal_key/Kconfig"
source "vendor/oplus/kernel/touchpanel/oplus_touchscreen/Synaptics/TD4320_noflash/Kconfig"
source "vendor/oplus/kernel/touchpanel/oplus_touchscreen/Synaptics/TD4160/Kconfig"
```

## vendor/oplus/kernel/touchpanel/oplus_touchscreen/ilitek/Kconfig
```kconfig
source "vendor/oplus/kernel/touchpanel/oplus_touchscreen/ilitek/ilitek9881h/Kconfig"
source "vendor/oplus/kernel/touchpanel/oplus_touchscreen/ilitek/ilitek9881h_v2/Kconfig"
source "vendor/oplus/kernel/touchpanel/oplus_touchscreen/ilitek/ilitek9881h_v3/Kconfig"
source "vendor/oplus/kernel/touchpanel/oplus_touchscreen/ilitek/ilitek9882n/Kconfig"
source "vendor/oplus/kernel/touchpanel/oplus_touchscreen/ilitek/ilitek7807s/Kconfig"
```
